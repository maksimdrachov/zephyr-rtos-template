## CMakeLists.txt
```
# SPDX-License-Identifier: Apache-2.0

cmake_minimum_required(VERSION 3.20.0)

# This sets common build options for all targets.
set(ZephyrBuildConfiguration_ROOT ${CMAKE_CURRENT_LIST_DIR}/../cmake/modules)
set(CMAKE_MODULE_PATH ${CMAKE_MODULE_PATH} ${CMAKE_CURRENT_LIST_DIR}/../cmake/modules)

find_package(Zephyr REQUIRED HINTS $ENV{ZEPHYR_BASE})

project(test_template)

FILE(GLOB app_sources src/*.cpp src/*.hpp)
target_sources(app PRIVATE ${app_sources})

# Setup Clang-Tidy
set_target_properties(
        app PROPERTIES
        INTERPROCEDURAL_OPTIMIZATION TRUE
        CMAKE_C_CLANG_TIDY "${clang_tidy}"
        CMAKE_CXX_CLANG_TIDY "${clang_tidy}"
)
```

## prj.conf
```kconfig
CONFIG_ZTEST=y
CONFIG_ZTEST_NEW_API=y

# C++ related
CONFIG_CPP=y
CONFIG_NEWLIB_LIBC=y
CONFIG_GLIBCXX_LIBCPP=y
```

## src/main.c
```c
#include <zephyr/ztest.h>
#include <zephyr/kernel.h>

ZTEST(template, test_template)
{
    zassert_true(true, "Some test failed");
    printk("test finished!\n");
}

ZTEST_SUITE(template, NULL, NULL, NULL, NULL, NULL);
```

## src/main.cpp
```c
#include <memory>  // for std::unique_ptr
#include <zephyr/ztest.h>

struct cpp_fixture
{
    int x;
};

ZTEST_SUITE(cpp, NULL, NULL, NULL, NULL, NULL);

ZTEST_F(cpp, test_fixture_created_and_initialized)
{
    std::unique_ptr<cpp_fixture> unique_cpp_struct(new cpp_fixture);
    unique_cpp_struct->x = 5;
    zassert_equal(5, unique_cpp_struct->x);
}
```
