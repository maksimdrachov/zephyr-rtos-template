## CMakeLists.txt
```
# SPDX-License-Identifier: Apache-2.0

cmake_minimum_required(VERSION 3.20.0)

# This sets common build options for all targets.
set(ZephyrBuildConfiguration_ROOT ${CMAKE_CURRENT_LIST_DIR}/../cmake/modules)
set(CMAKE_MODULE_PATH ${CMAKE_MODULE_PATH} ${CMAKE_CURRENT_LIST_DIR}/../cmake/modules)

find_package(Zephyr REQUIRED HINTS $ENV{ZEPHYR_BASE})
project(blinky)

# target_sources(app PRIVATE src/main.c)
target_sources(app PRIVATE src/main.cpp)
target_include_directories(app PRIVATE ${CMAKE_CURRENT_LIST_DIR}/src)

# Setup Clang-Tidy
set_target_properties(
        app PROPERTIES
        INTERPROCEDURAL_OPTIMIZATION TRUE
        CMAKE_C_CLANG_TIDY "${clang_tidy}"
        CMAKE_CXX_CLANG_TIDY "${clang_tidy}"
)
```

## prj.conf
```kconfig
CONFIG_GPIO=y
CONFIG_CPP=y
CONFIG_NEWLIB_LIBC=y
CONFIG_GLIBCXX_LIBCPP=y
```

## src/main.c
```c
/*
 * Copyright (c) 2016 Intel Corporation
 *
 * SPDX-License-Identifier: Apache-2.0
 */

#include <zephyr/kernel.h>
#include <zephyr/drivers/gpio.h>

/* 1000 msec = 1 sec */
#define SLEEP_TIME_MS 1000

/* The devicetree node identifier for the "led0" alias. */
#define LED0_NODE DT_ALIAS(led0)

/*
 * A build error on this line means your board is unsupported.
 * See the sample documentation for information on how to fix this.
 */
static const struct gpio_dt_spec led = GPIO_DT_SPEC_GET(LED0_NODE, gpios);

int main(void)
{
    int ret;
    int some_variable = 0;

    if (!gpio_is_ready_dt(&led))
    {
        return 0;
    }

    ret = gpio_pin_configure_dt(&led, GPIO_OUTPUT_ACTIVE);
    if (ret < 0)
    {
        return 0;
    }

    while (1)
    {
        ret = gpio_pin_toggle_dt(&led);
        if (ret < 0)
        {
            return 0;
        }
        k_msleep(SLEEP_TIME_MS);
    }
    return 0;
}
```

## src/main.cpp
```c
#include <zephyr/kernel.h>
#include <iostream>

int main()
{
    // int x;
    // std::cout << "The value of x is: " << x << std::endl;

    while (true)
    {
        k_sleep(K_MSEC(1000));
    }
}
```
